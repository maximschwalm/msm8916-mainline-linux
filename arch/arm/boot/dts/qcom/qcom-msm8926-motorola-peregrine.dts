// SPDX-License-Identifier: BSD-3-Clause

/dts-v1/;

#include "qcom-msm8226-motorola-common.dtsi"

/ {
	model = "Motorola Moto G 4G";
	compatible = "motorola,peregrine", "qcom,msm8926", "qcom,msm8226";
};

&aliases {
	mmc1 = &sdhc_2; /* SDC2 SD card slot */
};

&sdhc_2 {
	vmmc-supply = <&pm8226_l18>;
	vqmmc-supply = <&pm8226_l21>;

	bus-width = <4>;
	cd-gpios = <&tlmm 115 GPIO_ACTIVE_HIGH>;

	status = "okay";
};
